// DO NOT EDIT THIS FILE MANUALLY!
// Any change will be overwritten.

// This script is intended to be used internally by Trace 32 starter scripts.
// You are advised to use VPA menu 'Launch Debugger' to start Trace 32.

// It setups Trace 32 to connect to the running simulation via MCD.
// Usage:
//   DO setup_mcd_connection <cpuname>

LOCAL &cpu0 &cpu1 &cpu2 &cpu3 &cpu4 &cpu5 &cpu6 &cpu7 &cpu8 &cpu9 &cpu10 &cpu11 &cpu12 &cpu13 &cpu14 &cpu15 &guard
ENTRY &cpu0 &cpu1 &cpu2 &cpu3 &cpu4 &cpu5 &cpu6 &cpu7 &cpu8 &cpu9 &cpu10 &cpu11 &cpu12 &cpu13 &cpu14 &cpu15 &guard

IF "&(guard)"!=""
(
    DIALOG.OK "Too many cores in this subsystems"
    END
)

LOCAL &cmdArg &starterKey

&starterKey="51cb5e45-20e6-41b0-ac7d-7d0536b1ee11"

&cmdArg="&(cpu0)||&(starterKey)"
IF "&(cpu1)"!=""
(
    &cmdArg="&(cmdArg),&(cpu1)||&(starterKey)"
)
IF "&(cpu2)"!=""
(
    &cmdArg="&(cmdArg),&(cpu2)||&(starterKey)"
)
IF "&(cpu3)"!=""
(
    &cmdArg="&(cmdArg),&(cpu3)||&(starterKey)"
)
IF "&(cpu4)"!=""
(
    &cmdArg="&(cmdArg),&(cpu4)||&(starterKey)"
)
IF "&(cpu5)"!=""
(
    &cmdArg="&(cmdArg),&(cpu5)||&(starterKey)"
)
IF "&(cpu6)"!=""
(
    &cmdArg="&(cmdArg),&(cpu6)||&(starterKey)"
)
IF "&(cpu7)"!=""
(
    &cmdArg="&(cmdArg),&(cpu7)||&(starterKey)"
)
IF "&(cpu8)"!=""
(
    &cmdArg="&(cmdArg),&(cpu8)||&(starterKey)"
)
IF "&(cpu9)"!=""
(
    &cmdArg="&(cmdArg),&(cpu9)||&(starterKey)"
)
IF "&(cpu10)"!=""
(
    &cmdArg="&(cmdArg),&(cpu10)||&(starterKey)"
)
IF "&(cpu11)"!=""
(
    &cmdArg="&(cmdArg),&(cpu11)||&(starterKey)"
)
IF "&(cpu12)"!=""
(
    &cmdArg="&(cmdArg),&(cpu12)||&(starterKey)"
)
IF "&(cpu13)"!=""
(
    &cmdArg="&(cmdArg),&(cpu13)||&(starterKey)"
)
IF "&(cpu14)"!=""
(
    &cmdArg="&(cmdArg),&(cpu14)||&(starterKey)"
)
IF "&(cpu15)"!=""
(
    &cmdArg="&(cmdArg),&(cpu15)||&(starterKey)"
)

SYStem.CONFIG CORE "&(cmdArg)"

ENDDO
